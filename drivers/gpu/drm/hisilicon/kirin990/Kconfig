## drivers/gpu/drm/hisilicon/kirin990/Kconfig
```kconfig
# SPDX-License-Identifier: GPL-2.0-only
config DRM_KIRIN990
	tristate "DRM support for the HiSilicon Kirin 990 display subsystem"
	depends on DRM && OF && (ARM64 || COMPILE_TEST)
	depends on I2C
	depends on BACKLIGHT_CLASS_DEVICE
	select DRM_CLIENT_SELECTION
	select DRM_DISPLAY_DP_HELPER
	select DRM_DISPLAY_HELPER
	select DRM_KMS_HELPER
	select DRM_GEM_DMA_HELPER
	help
	  Display subsystem (DSS v510) of the HiSilicon Kirin 990 SoC, as used
	  in the Huawei Qingyun L410 laptop, with its MIPI DSI host and the
	  panel's SN65DSI86 DSI-to-eDP bridge. The DRM driver is called
	  "kirin", so that Mesa pairs it with the Panfrost GPU driver.
```

## drivers/media/platform/hisilicon/Kconfig
```kconfig
# SPDX-License-Identifier: GPL-2.0-only

comment "HiSilicon media platform drivers"

source "drivers/media/platform/hisilicon/vdec/Kconfig"
```

## drivers/media/platform/hisilicon/vdec/Kconfig
```kconfig
# SPDX-License-Identifier: GPL-2.0-only
config VIDEO_HISI_VDEC
	tristate "HiSilicon Kirin 990 video decoder"
	depends on V4L_MEM2MEM_DRIVERS
	depends on VIDEO_DEV
	depends on ARCH_HISI || COMPILE_TEST
	select MEDIA_CONTROLLER
	select VIDEOBUF2_DMA_SG
	select V4L2_MEM2MEM_DEV
	select V4L2_H264
	select V4L2_VP9
	select IOMMU_IO_PGTABLE_LPAE
	select GENERIC_ALLOCATOR
	help
	  Stateless (request API) decoder for the VDH block of the HiSilicon
	  Kirin 990 video codec (VCodec V500).

	  To compile this driver as a module, choose M here: the module
	  will be called hisi-vdec.
```

## drivers/soc/hisilicon/Kconfig
```kconfig
# SPDX-License-Identifier: GPL-2.0-only

menu "Hisilicon SoC drivers"
	depends on ARCH_HISI || COMPILE_TEST

config KIRIN_HW_VOTE
	bool "HiSilicon Kirin 990 hardware vote (PMCTRL)"
	depends on ARCH_HISI || COMPILE_TEST
	depends on OF && HAS_IOMEM
	help
	  Frequency and voltage requests to the LPM3 power controller of the
	  HiSilicon Kirin 990 (Huawei Qingyun L410), used by cpufreq and the
	  peripheral DVFS code.

config KIRIN_PERI_DVFS
	bool "HiSilicon Kirin 990 peripheral voltage voting"
	depends on KIRIN_HW_VOTE && HWSPINLOCK
	help
	  Lets the Kirin 990 clock driver raise the shared peripheral rail
	  before fast peripheral clocks are enabled (vendor "peri DVFS"),
	  through PMCTRL and the LPM3 hardware vote.

config KUNPENG_HCCS
	tristate "HCCS driver on Kunpeng SoC"
	depends on ACPI
	depends on PCC
	depends on ARM64 || COMPILE_TEST
	help
	  The Huawei Cache Coherence System (HCCS) is a multi-chip
	  interconnection bus protocol.
	  The performance of application may be affected if some HCCS
	  ports are not in full lane status, have a large number of CRC
	  errors and so on. This may support for reducing system power
	  consumption if there are HCCS ports supported low power feature
	  on platform.

	  Say M here if you want to include support for querying the
	  health status and port information of HCCS, or reducing system
	  power consumption on Kunpeng SoC.

config L410_DEADMAN
	bool "Huawei L410 bring-up deadman watchdog"
	depends on ARM64
	help
	  Arms the Kirin 990 AP SP805 watchdog early in boot and never pets it,
	  so a hung or unreachable test kernel resets the machine back to the
	  default boot entry. Only useful while bringing up new kernels on the
	  Huawei L410; boot with l410_deadman=0 to disable.

config KIRIN990_SUSPEND
	bool "HiSilicon Kirin 990 system suspend"
	depends on ARM64 && ARM_PSCI_FW && CPU_IDLE && SUSPEND
	help
	  Enter "deep" system suspend the way the vendor kernel does: flag
	  the suspend in SCTRL and enter the cluster sleep state, so the
	  firmware hands the system to LPM3.  Without this, "deep" is PSCI
	  SYSTEM_SUSPEND, which this firmware never supported in practice.
	  The board does not resume from it yet, so suspend-to-idle stays
	  the default; kirin990_sr.deep=1 makes "deep" the default.

config L410_PERF
	bool "Huawei L410 performance modes and interaction boosts"
	depends on ARM64 && CPU_FREQ && PM && INPUT && OF
	help
	  Power / balanced / performance modes for the Kirin 990 (Huawei
	  Qingyun L410) and short CPU, GPU and memory frequency floors while
	  the user interacts, starts an application or an animation runs
	  (input boost, launch boost). Uses the PM QoS interfaces only, so
	  thermal limits always win. Controlled from /sys/kernel/l410_perf/.

endmenu
```

## drivers/staging/hi110x/Kconfig
```kconfig
# SPDX-License-Identifier: GPL-2.0
config HI110X
	tristate "HiSilicon Hi1103/Hi1105 WiFi and Bluetooth (vendor driver)"
	depends on ARM64 && OF && PCI && CFG80211 && I2C && MMC && SERIAL_DEV_BUS
	depends on BT
	select WIRELESS_EXT
	select WEXT_PRIV
	select CRC32
	help
	  Host driver for the HiSilicon Hi110x connectivity chip as used on the
	  Huawei Qingyun L410 (Kirin 990): WiFi over PCIe (19e5:1103), Bluetooth
	  over the BUART serial port. Ported from the vendor 4.19 kernel.

	  The chip firmware is read from /vendor/firmware/hi1103 and the board
	  configuration from /vendor/etc/cfg_udp_1103_pilot.ini.

	  The module is called hi110x.
```

## sound/soc/hisilicon/hi6405/Kconfig
```kconfig
# SPDX-License-Identifier: GPL-2.0-only
config SND_SOC_HI6405_L410
	tristate "HiSilicon Hi6405 codec on Kirin 990 (Huawei L410)"
	depends on ARCH_HISI || COMPILE_TEST
	depends on OF && GPIOLIB && COMMON_CLK
	select REGMAP
	help
	  Audio support for the Huawei Qingyun L410 (Kirin 990): the Hi6405
	  codec (register access over the codec SSI, audio data over the
	  Cadence SLIMbus manager in the ASP), the ASP DMA based PCM and the
	  machine driver binding the codec and the TAS2562 speaker amplifiers.
```
